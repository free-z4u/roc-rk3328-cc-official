## drivers/gpu/drm/bridge/Kconfig
```kconfig
config DRM_BRIDGE
	def_bool y
	depends on DRM
	help
	  Bridge registration and lookup framework.

menu "Display Interface Bridges"
	depends on DRM && DRM_BRIDGE

config DRM_ANALOGIX_ANX78XX
	tristate "Analogix ANX78XX bridge"
	select DRM_KMS_HELPER
	select REGMAP_I2C
	---help---
	  ANX78XX is an ultra-low Full-HD SlimPort transmitter
	  designed for portable devices. The ANX78XX transforms
	  the HDMI output of an application processor to MyDP
	  or DisplayPort.

config DRM_NXP_PTN3460
	tristate "NXP PTN3460 DP/LVDS bridge"
	depends on OF
	select DRM_KMS_HELPER
	select DRM_PANEL
	---help---
	  NXP PTN3460 eDP-LVDS bridge chip driver.

config DRM_PARADE_PS8622
	tristate "Parade eDP/LVDS bridge"
	depends on OF
	select DRM_PANEL
	select DRM_KMS_HELPER
	select BACKLIGHT_LCD_SUPPORT
	select BACKLIGHT_CLASS_DEVICE
	---help---
	  Parade eDP-LVDS bridge chip driver.

config DRM_SII902X
	tristate "Silicon Image sii902x RGB/HDMI bridge"
	depends on OF
	select DRM_KMS_HELPER
	select REGMAP_I2C
	---help---
	  Silicon Image sii902x bridge chip driver.

source "drivers/gpu/drm/bridge/analogix/Kconfig"

source "drivers/gpu/drm/bridge/synopsys/Kconfig"

endmenu
```

## drivers/phy/rockchip/Kconfig
```kconfig
# SPDX-License-Identifier: GPL-2.0
#
# Phy drivers for Rockchip platforms
#

config PHY_ROCKCHIP_INNO_USB3
	tristate "Rockchip INNO USB 3.0 PHY Driver"
	depends on ARCH_ROCKCHIP && OF
	select GENERIC_PHY
	select USB_PHY
	help
	  Support for Rockchip USB 3.0 PHY with Innosilicon IP block.

config PHY_ROCKCHIP_INNO_MIPI_DPHY
	tristate "Rockchip INNO MIPI D-PHY Driver"
	depends on ARCH_ROCKCHIP && OF
	select GENERIC_PHY
	help
	  Enable this to support the Rockchip MIPI D-PHY with Innosilicon IP block.

config PHY_ROCKCHIP_INNO_HDMI_PHY
	tristate "Rockchip INNO HDMI PHY Driver"
	depends on ARCH_ROCKCHIP && OF
	select GENERIC_PHY
	help
	  Enable this to support the Rockchip HDMI PHY with Innosilicon IP block.
```
